; *************************************************************
; *** Scatter-Loading Description File for RTL8195BHP       ***
; *************************************************************

LR_DTCM 0x20000000 0x00008000  {    ; load region size_region
  _DTCM_RAM 0x20000000 UNINIT FIXED {
	* (.dtcm_ram.bss*)
  }
  
  _STACK 0x2000F000 UNINIT FIXED {
  	ram_start.o (.stack)
  }
}

LR_PSRAM 0x60000000 0x100000  {    ; load region size_region

  _PSRAM_DATA 0x60000000 FIXED {
	*(.psram.data*)
  }

  _PSRAM_CODE +0 FIXED {
	*(.psram.text*)
  }

  _PSRAM_RODATA +0 FIXED {
	*(.psram.rodata*)
  }

  _PSRAM_BSS +0 UNINIT FIXED {
	*(.psram.bss*)
  }
}

LR_LPDDR 0x71C00000 0x400000  {    ; load region size_region

  _LPDDR_DATA 0x70000000 FIXED {
	*(.lpddr.data*)
  }

  _LPDDR_CODE +0 FIXED {
	*(.lpddr.text*)
  }

  _LPDDR_RODATA +0 FIXED {
	*(.lpddr.rodata*)
  }

  _LPDDR_BSS +0 UNINIT FIXED {
	*(.lpddr.bss*)
  }
}

LR_RAM 0x20120000 0x20000  {    ; load region size_region
  _RAM_NSC 0x20120000 FIXED 0x8000 {
	*.o (.ns_entry_func.text*)
	anon$$obj.o(Veneer$$CMSE)
  }
  
  _RAM_CODE 0x20128000 FIXED 0x15000 {
    .ANY (+RO)
  }
  
  _RAM_DATA +0 FIXED {
    .ANY (+RW)
  }

  _RAM_BSS +0 UNINIT FIXED {
    .ANY (+ZI)
  }

  _RAM_NC 0x2013D000 FIXED 0x2A00 {	; Non-cacheable RAM
	*.o (.non_cache.data*)
  }

  _RAM_FUNC_TBL 0x2013FA00 FIXED 0xF0 {
    ram_start.o(.start.ram.data.a)
  }

  _RAM_IMG_SIGN 0x2013FAF0 FIXED 0x10  {
    ram_start.o (.start.ram.sign)
  }

  _RAM_VECTOR 0x2013FB00 FIXED 0x100 {  ; RW data
	*.o (.ram_vector_table)
  }
  
  _RAM_SHARED 0x20140000 FIXED 0x3A000 {
    ;shared by CPU and Video Encoder, CPU can use it only when Video Encoder is off
    *.o (.share_ram*)
  }
}
